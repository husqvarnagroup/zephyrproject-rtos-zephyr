## drivers/hwinfo/Kconfig.si32
```kconfig
config HWINFO_SI32
	bool "Si32 hwinfo"
	default y
	depends on SOC_FAMILY_SILABS_SIM3
	help
	  Enable Si32 hwinfo driver.
```

## drivers/hwinfo/Kconfig.silabs_si32
```kconfig
# Copyright (c) 2025 GARDENA GmbH
#
# SPDX-License-Identifier: Apache-2.0

config HWINFO_SI32
	bool "Si32 hwinfo"
	default y
	depends on SOC_FAMILY_SILABS_SIM3
	help
	  Enable Si32 hwinfo driver.
```

## dts/bindings/rf-transceiver/silabs,si4467.yaml
```yaml
# Copyright (c) 2025 GARDENA GmbH
# SPDX-License-Identifier: Apache-2.0

description: Silicon Labs Si4467 Sub-GHz transceiver

compatible: "silabs,si4467"

include: [spi-device.yaml]

properties:
    nirq-gpios:
      type: phandle-array
      required: true
      description: |
        Per default, the interrupt pin nIRQ of the Si4467 is active low input
        on the MCU.

    sdn-gpios:
      type: phandle-array
      required: true
      description: |
        The shutdown (SDN) pin of the Si4467 is active high.

    gpio-0-gpios:
      type: phandle-array
      required: false
      description: |
        The MCU pin connected to the Si4467 GPIO 0

    gpio-1-gpios:
      type: phandle-array
      required: false
      description: |
        The MCU pin connected to the Si4467 GPIO 1

    gpio-2-gpios:
      type: phandle-array
      required: false
      description: |
        The MCU pin connected to the Si4467 GPIO 1

    gpio-3-gpios:
      type: phandle-array
      required: false
      description: |
        The MCU pin connected to the Si4467 GPIO 3

    xtal-frequency:
      type: int
      required: true
      description: |
        Clock frequency of XTAL in Hz.

    xtal-capacitor-tune-value:
      type: int
      required: false
      description: |
        Clock crystal capacitor tune value.

        This controls the capacitance of the internal capacitors for the
        crystal oscillator. The range is from 0 to 0x7f inclusive and each LSB
        step corresponds to ~70 fF change in capacitance. The ideal value must
        be determined experimentally and it can be left blank if individual
        calibration per device is used.

    rx-rssi-offset:
      type: int
      required: false
      description: |
        RSSI offset in RX path due to analog front-end. Subtracted from RSSI
        value as reported by the Si4467 transceiver to get corrected value.
```

## samples/subsys/factory_data/sample.yaml
```yaml
sample:
  name: Factory data sample
common:
  tags: factory_data
  depends_on: eeprom
tests:
  sample.subsys.factory_data.read_write:
    platform_allow:
      - gd32f450i_eval
      - native_sim
      - native_sim/native/64
    harness: console
    harness_config:
      type: multi_line
      regex:
        - "Above values are boring\\? Use the factory data shell to manipulate them\\!"
  sample.subsys.factory_data.read_only:
    extra_args: CONF_FILE=read_only.conf
    platform_allow:
      - native_sim
      - native_sim/native/64
    harness: console
    harness_config:
      type: multi_line
      regex:
        # Can't initialize, missing write capabilities
        - "Failed to initialize factory data: -13"
```

## tests/boards/gardena/sgrm/testcase.yaml
```yaml
# Copyright (c) 2025 GARDENA GmbH
#
# SPDX-License-Identifier: Apache-2.0

tests:
  boards.gardena.sgrm.spi-si4467
    depends_on: spi
    tags:
      - drivers
      - spi
    filter: dt_alias_exists("spi-si4467")
```

## tests/subsys/factory_data/generic/testcase.yaml
```yaml
common:
  tags: factory_data
  platform_allow:
    - native_sim
    - native_sim/native/64
    - nrf52840dk/nrf52840
tests:
  factory_data.fcb:
    extra_args: OVERLAY_CONFIG=fcb.conf
  factory_data.lv:
    extra_args: CONFIG_FACTORY_DATA_LV=y
  factory_data.dummy:
    extra_args: CONFIG_FACTORY_DATA_DUMMY=y
    build_only: true
```

## tests/subsys/factory_data/uninitialized/testcase.yaml
```yaml
common:
  tags: factory_data
  platform_allow:
    - native_sim
    - native_sim/native/64
    - nrf52840dk/nrf52840
tests:
  factory_data_uninitialized.fcb:
    extra_args: OVERLAY_CONFIG=fcb.conf
  factory_data_uninitialized.lv:
    extra_args: CONFIG_FACTORY_DATA_LV=y
  factory_data_uninitialized.dummy:
    extra_args: CONFIG_FACTORY_DATA_DUMMY=y
    build_only: true
```
