## CMakeLists.txt
```
# Copyright (c) 2025 GARDENA GmbH
#
# SPDX-License-Identifier: Apache-2.0

cmake_minimum_required(VERSION 3.20.0)

find_package(Zephyr REQUIRED HINTS $ENV{ZEPHYR_BASE})

project(spi_si4467)

target_sources(app PRIVATE src/main.c)
```

## prj.conf
```kconfig
# Copyright (c) 2025 GARDENA GmbH
#
# SPDX-License-Identifier: Apache-2.0

# Test is implemented as Ztest
CONFIG_ZTEST=y

# The Si4467 is used via SPI
CONFIG_SPI=y

# Enabling longs help with debugging, spotting problems
CONFIG_LOG=y
CONFIG_SPI_LOG_LEVEL_INF=y
```

## boards/sgrm.overlay
```dts
/*
 * Copyright (c) 2025 GARDENA GmbH
 *
 * SPDX-License-Identifier: Apache-2.0
 */

/ {
	aliases {
		spi-si4467 = &spi2;
	};
};

&spi2 {
	status = "okay";
};
```

## src/main.c
```c
/*
 * Copyright (c) 2025 GARDENA GmbH
 *
 * SPDX-License-Identifier: Apache-2.0
 */

#include <zephyr/kernel.h>
#include <zephyr/ztest.h>

ZTEST_SUITE(spi_si4467, NULL, NULL, NULL, NULL, NULL);
```
